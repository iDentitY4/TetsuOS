## Config.in
```kconfig
source "$BR2_EXTERNAL_TETSU_PATH/package/freedoom/Config.in"
source "$BR2_EXTERNAL_TETSU_PATH/package/libretro-arduous/Config.in"
source "$BR2_EXTERNAL_TETSU_PATH/package/libretro-beetle-ngp/Config.in"
source "$BR2_EXTERNAL_TETSU_PATH/package/libretro-beetle-pce-fast/Config.in"
source "$BR2_EXTERNAL_TETSU_PATH/package/libretro-beetle-vb/Config.in"
source "$BR2_EXTERNAL_TETSU_PATH/package/libretro-beetle-wswan/Config.in"
source "$BR2_EXTERNAL_TETSU_PATH/package/libretro-fceumm/Config.in"
source "$BR2_EXTERNAL_TETSU_PATH/package/libretro-genesis-plus-gx/Config.in"
source "$BR2_EXTERNAL_TETSU_PATH/package/libretro-handy/Config.in"
source "$BR2_EXTERNAL_TETSU_PATH/package/libretro-mgba/Config.in"
source "$BR2_EXTERNAL_TETSU_PATH/package/libretro-nxengine/Config.in"
source "$BR2_EXTERNAL_TETSU_PATH/package/libretro-pcsx-rearmed/Config.in"
source "$BR2_EXTERNAL_TETSU_PATH/package/libretro-picodrive/Config.in"
source "$BR2_EXTERNAL_TETSU_PATH/package/libretro-pokemini/Config.in"
source "$BR2_EXTERNAL_TETSU_PATH/package/libretro-potator/Config.in"
source "$BR2_EXTERNAL_TETSU_PATH/package/libretro-prboom/Config.in"
source "$BR2_EXTERNAL_TETSU_PATH/package/libretro-prosystem/Config.in"
source "$BR2_EXTERNAL_TETSU_PATH/package/libretro-snes9x/Config.in"
source "$BR2_EXTERNAL_TETSU_PATH/package/libretro-stella/Config.in"
source "$BR2_EXTERNAL_TETSU_PATH/package/libretro-tamalib/Config.in"
source "$BR2_EXTERNAL_TETSU_PATH/package/libretro-vecx/Config.in"
source "$BR2_EXTERNAL_TETSU_PATH/package/launcher/Config.in"
source "$BR2_EXTERNAL_TETSU_PATH/package/syncthing/Config.in"
```

## package/freedoom/Config.in
```kconfig
config BR2_PACKAGE_FREEDOOM
	bool "freedoom"
	help
	  Freedoom: Phase 1 and Phase 2, free games for Doom engines,
	  installed for the launcher to copy to TETSU-DATA.

	  https://freedoom.github.io
```

## package/launcher/Config.in
```kconfig
config BR2_PACKAGE_LAUNCHER
	bool "launcher"
	depends on BR2_PACKAGE_HOST_RUSTC_TARGET_ARCH_SUPPORTS
	select BR2_PACKAGE_HOST_RUSTC
	help
	  The game launcher and libretro frontend for the RG35XX SP,
	  drawing to the framebuffer.
```

## package/libretro-arduous/Config.in
```kconfig
config BR2_PACKAGE_LIBRETRO_ARDUOUS
	bool "libretro-arduous"
	help
	  The Arduous emulator, as a libretro core: Arduboy.

	  https://github.com/libretro/arduous
```

## package/libretro-beetle-ngp/Config.in
```kconfig
config BR2_PACKAGE_LIBRETRO_BEETLE_NGP
	bool "libretro-beetle-ngp"
	help
	  The Beetle NeoPop emulator, as a libretro core: Neo Geo Pocket
	  and Neo Geo Pocket Color.

	  https://github.com/libretro/beetle-ngp-libretro
```

## package/libretro-beetle-pce-fast/Config.in
```kconfig
config BR2_PACKAGE_LIBRETRO_BEETLE_PCE_FAST
	bool "libretro-beetle-pce-fast"
	help
	  The Beetle PCE Fast emulator, as a libretro core: PC Engine.

	  https://github.com/libretro/beetle-pce-fast-libretro
```

## package/libretro-beetle-vb/Config.in
```kconfig
config BR2_PACKAGE_LIBRETRO_BEETLE_VB
	bool "libretro-beetle-vb"
	help
	  The Beetle VB emulator (Mednafen), as a libretro core: Virtual Boy.

	  https://github.com/libretro/beetle-vb-libretro
```

## package/libretro-beetle-wswan/Config.in
```kconfig
config BR2_PACKAGE_LIBRETRO_BEETLE_WSWAN
	bool "libretro-beetle-wswan"
	help
	  The Beetle Cygne emulator, as a libretro core: WonderSwan and
	  WonderSwan Color.

	  https://github.com/libretro/beetle-wswan-libretro
```

## package/libretro-fceumm/Config.in
```kconfig
config BR2_PACKAGE_LIBRETRO_FCEUMM
	bool "libretro-fceumm"
	help
	  The FCEUmm NES emulator, as a libretro core.

	  https://github.com/libretro/libretro-fceumm
```

## package/libretro-genesis-plus-gx/Config.in
```kconfig
config BR2_PACKAGE_LIBRETRO_GENESIS_PLUS_GX
	bool "libretro-genesis-plus-gx"
	help
	  The Genesis Plus GX emulator, as a libretro core: Sega Mega
	  Drive, Master System and Game Gear.

	  https://github.com/libretro/Genesis-Plus-GX
```

## package/libretro-handy/Config.in
```kconfig
config BR2_PACKAGE_LIBRETRO_HANDY
	bool "libretro-handy"
	help
	  The Handy emulator, as a libretro core: Atari Lynx.

	  https://github.com/libretro/libretro-handy
```

## package/libretro-mgba/Config.in
```kconfig
config BR2_PACKAGE_LIBRETRO_MGBA
	bool "libretro-mgba"
	help
	  The mGBA Game Boy Advance emulator, as a libretro core.

	  https://github.com/libretro/mgba
```

## package/libretro-nxengine/Config.in
```kconfig
config BR2_PACKAGE_LIBRETRO_NXENGINE
	bool "libretro-nxengine"
	help
	  NXEngine, a rewrite of the Cave Story engine, as a libretro
	  core. The freeware game's data comes with it and is
	  installed for the launcher to copy to TETSU-DATA.

	  https://github.com/libretro/nxengine-libretro
```

## package/libretro-pcsx-rearmed/Config.in
```kconfig
config BR2_PACKAGE_LIBRETRO_PCSX_REARMED
	bool "libretro-pcsx-rearmed"
	help
	  The PCSX ReARMed PlayStation emulator, as a libretro core,
	  with a dynamic recompiler for ARM. It runs games without a
	  BIOS file through its own BIOS replacement.

	  https://github.com/libretro/pcsx_rearmed
```

## package/libretro-picodrive/Config.in
```kconfig
config BR2_PACKAGE_LIBRETRO_PICODRIVE
	bool "libretro-picodrive"
	help
	  The PicoDrive emulator, as a libretro core: Sega 32X.

	  https://github.com/libretro/picodrive
```

## package/libretro-pokemini/Config.in
```kconfig
config BR2_PACKAGE_LIBRETRO_POKEMINI
	bool "libretro-pokemini"
	help
	  The PokeMini emulator, as a libretro core: Pokemon Mini.

	  https://github.com/libretro/PokeMini
```

## package/libretro-potator/Config.in
```kconfig
config BR2_PACKAGE_LIBRETRO_POTATOR
	bool "libretro-potator"
	help
	  The Potator emulator, as a libretro core: Watara Supervision.

	  https://github.com/libretro/potator
```

## package/libretro-prboom/Config.in
```kconfig
config BR2_PACKAGE_LIBRETRO_PRBOOM
	bool "libretro-prboom"
	help
	  PrBoom, a Doom engine, as a libretro core: Doom, Doom II,
	  Final Doom and Freedoom WADs.

	  https://github.com/libretro/libretro-prboom
```

## package/libretro-prosystem/Config.in
```kconfig
config BR2_PACKAGE_LIBRETRO_PROSYSTEM
	bool "libretro-prosystem"
	help
	  The ProSystem emulator, as a libretro core: Atari 7800.

	  https://github.com/libretro/prosystem-libretro
```

## package/libretro-snes9x/Config.in
```kconfig
config BR2_PACKAGE_LIBRETRO_SNES9X
	bool "libretro-snes9x"
	help
	  The Snes9x SNES emulator, as a libretro core. Free for
	  non-commercial use only.

	  https://github.com/libretro/snes9x
```

## package/libretro-stella/Config.in
```kconfig
config BR2_PACKAGE_LIBRETRO_STELLA
	bool "libretro-stella"
	help
	  The Stella emulator, as a libretro core: Atari 2600.

	  https://github.com/stella-emu/stella
```

## package/libretro-tamalib/Config.in
```kconfig
config BR2_PACKAGE_LIBRETRO_TAMALIB
	bool "libretro-tamalib"
	help
	  TamaLIBretro, an emulator of the first Tamagotchi handheld, as a
	  libretro core. It needs a ROM dump to run.

	  https://github.com/celerizer/tamalibretro
```

## package/libretro-vecx/Config.in
```kconfig
config BR2_PACKAGE_LIBRETRO_VECX
	bool "libretro-vecx"
	help
	  The vecx emulator, as a libretro core: Vectrex.

	  https://github.com/libretro/libretro-vecx
```
