## package/syncthing/Config.in
```kconfig
config BR2_PACKAGE_SYNCTHING
	bool "syncthing"
	depends on BR2_aarch64
	help
	  Syncthing, the official static arm64 build, which SAVE BACKUP
	  runs to keep the saves on other devices.

	  https://syncthing.net
```

## package/welcome/Config.in
```kconfig
config BR2_PACKAGE_WELCOME
	bool "welcome"
	depends on BR2_PACKAGE_HOST_RUSTC_TARGET_ARCH_SUPPORTS
	select BR2_PACKAGE_HOST_RUSTC
	help
	  Framebuffer welcome screen for the RG35XX SP.
```
